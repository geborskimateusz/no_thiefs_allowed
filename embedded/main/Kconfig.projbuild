## embedded/main/Kconfig.projbuild
```kconfig
menu "No thiefs Allowed Reed Switch Config"

config WIFI_SSID
    string "Wi-Fi SSID"
    default "MyWiFi"
    help
        Enter the SSID for the Wi-Fi network the ESP32 should connect to.

config WIFI_PASSWORD
    string "Wi-Fi Password"
    default "MyPassword"
    help
        Enter the password for the Wi-Fi network.

config WEB_SERVER_URL
    string "IP of web server"
    default "XXXXXXXXXX"
    help
        Enter the ${ip}:${port} to make api calls

config WEB_SERVER_TOKEN
    string "Auth Token for web server"
    default "XXXXXXXXXX"
    help
        Enter the token to make api calls
endmenu
```
